## boards/shields/rotate/Kconfig.defconfig
```kconfig
if SHIELD_ROTATE

config ZMK_KEYBOARD_NAME
    default "Rotate"

endif # SHIELD_ROTATE
```

## boards/shields/sonnet/Kconfig.defconfig
```kconfig
if SHIELD_SONNET

config ZMK_KEYBOARD_NAME
    default "Sonnet"

endif # SHIELD_SONNET
```

## boards/shields/sonnet/Kconfig.shield
```kconfig
# Sonnet shield definition
config SHIELD_SONNET
    def_bool $(shields_list_contains,sonnet)
```
